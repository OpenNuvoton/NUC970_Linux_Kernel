## arch/arm/mach-nuc970/Kconfig
```kconfig
if ARCH_NUC970

config CPU_NUC970
	bool
	select HAVE_CLK_PREPARE
	select HAVE_MACH_CLKDEV
	select COMMON_CLK
	help
	  Support for NUC970 of Nuvoton microprocessor
config CPU_N9H30
	bool
	select HAVE_CLK_PREPARE
	select HAVE_MACH_CLKDEV
	select COMMON_CLK
	help
		Support for N9H30 of Nuvoton microprocessor


config MACH_NUC970
	bool
	default y

choice
	prompt "Select NUC970/N9H30 processor"

config CPU_NUC970
	bool "NUC970 Series Microprocessor"

config CPU_N9H30
	bool "N9H30 Series Microprocessor"

endchoice

choice
    prompt "Nuvoton NUC970/N9H30 Series Development Board"

config BOARD_NUC977
	depends on !USE_OF
    bool "NUC977 Development Board"

config BOARD_NUC972
	depends on !USE_OF
    bool "NUC972 Development Board"

config BOARD_TOMATO
	depends on !USE_OF
    bool "NUC976 Tomato Board"

config BOARD_ETH2UART
	depends on !USE_OF
    bool "NUC972 Ethernet To UART Board"

config BOARD_HMI
	depends on !USE_OF
   bool "N9H30 HMI Demo Board"

config MACH_NUC972_EVB_DT
	bool "Nuvoton NUC972 evaluation board using device tree"
	depends on USE_OF
	help
	  Machine support for Nuvoton NUC972 machine with device tree enabled.
	  Note: This is under development and not all peripherals can be supported
	  with this machine file.

endchoice

config NUC970_FIQ
    bool "Nuvoton NUC970/N9H30 FIQ support"
    select FIQ
    ---help---
	  Support FIQ in NUC970/N9H30. For more information, please refer to NUC970/N9H30
	  BSP user's manual.

endif

choice
    prompt "Nuvoton NUC970/N9H30 System Clock Selection"
	help
	  To support NO_HZ or HRTIMER, ETIMER must be used as system clock source.
          NOTE: If ETIMER is selected, ETIMER0/1will be used as system clock souce and
          clock event and cannot used for capture or toggle out.

config NUC970_CLK_TIMER
    bool "TIMER as system clock source"
    select ARCH_USES_GETTIMEOFFSET

config NUC970_CLK_ETIMER
    bool "ETIMER as system clock source"

endchoice
```

## drivers/input/nuvoton/Kconfig
```kconfig
#
# Input core configuration
#
menuconfig NUC970_ADC
	tristate "Input NUC970/N9H30 ADC"
        help
          Say Y here, here to enable the NUC970/N9H30 adc on evaluation board.
          This option doesn't affect the kernel.

          If unsure, say Y.
if NUC970_ADC
config KEYBOARD_NUC970ADC
        tristate "Keypad support"
        depends on ARCH_NUC970
        help
          Say Y here to enable the keypad on evaluation board
          based on NUC970/N9H30.

	  To compile this driver as a module, choose M here: the
          module will be called nuc970adc keypad

config KEYBOARD_NUC970ADC_WKUP
        tristate "Keypad wake-up support"
        depends on KEYBOARD_NUC970ADC
        help
          Say Y here to enable the keypad wakeup function on evaluation board
          based on NUC970/N9H30.

config TOUCHSCREEN_NUC970ADC
        tristate "Touchscreen support"
        depends on ARCH_NUC970
        help
          Say Y here to enable the touchscreen on evaluation board
          base on NUC970/N9H30.

          To compile this driver as a module, choose M here: the
          module will be called nuc970adc touchscreen.
config TOUCHSCREEN_NUC970ADC_WKUP
        tristate "Touchscreen wake-up support"
        depends on TOUCHSCREEN_NUC970ADC
        help
          Say Y here to enable the touchscreen wakeup function on evaluation board
          base on NUC970/N9H30.

config SAMPLE_NUC970ADC
        int "ADC Sample Counter"
        depends on NUC970_ADC
        default "200"
        help
	  Set the counter value to extend the ADC start signal period
          to get more sampling time for precise conversion.
	  It should be 0 ~ 255

#config BATTREY_NUC970ADC
#        tristate "Battrey support"
#        depends on ARCH_NUC970
#        help
#          Say Y here to enable the battrey on evaluation board
#          base on NUC970.
#
#          To compile this driver as a module, choose M here: the
#          module will be called nuc970adc battrey.

endif
```

## drivers/media/i2c/nuvoton/Kconfig
```kconfig
config VIDEO_NUC970
	tristate "Nuvoton NUC970/N9H30 Video-In Support"
	depends on I2C && VIDEO_DEV
	select VIDEO_BUF
	select VIDEOBUF_DMA_CONTIG
	---help---
	Support for built-in video-in interface for NUC970/N9H30.
config MAX_DEVICES
	int "Max video device"
	depends on VIDEO_NUC970
	default "2"
	---help---
	MAX_DEVICES set to 1, /dev/video0 support packet
	or planar.
	MAX_DEVICES set to 2, /dev/video0 support packet
	and /dev/video1 support planar at same time.

config MAX_FRAME_BUFFER
	int "Max frame buffer"
	depends on VIDEO_NUC970
	default "3"
config VIDOE_FREQ
	int "Video frequency"
	depends on VIDEO_NUC970
	default "24000000"

choice
	prompt "Nuvoton NUC970/N9H30 Sensor Power Down Pin Selection"
	depends on VIDEO_NUC970
	default SENSOR_PD_PI0
        ---help---
        NUC972 EV-board sensor powerdown pin use PI0.
	NUC977 EV-board sensor powerdown pin use PI2.

config	SENSOR_PD_PI0
	bool "PD_PI0"
        ---help---
        NUC972 EV-board sensor powerdown pin use PI0.
        NUC977 EV-board sensor powerdown pin use PI2.

config SENSOR_PD_PI2
	bool "PD_PI2"
        ---help---
        NUC972 EV-board sensor powerdown pin use PI0.
        NUC977 EV-board sensor powerdown pin use PI2.

endchoice

if !OF
choice
	prompt "Nuvoton NUC970/N9H30 Image Sensor Selection"
	depends on VIDEO_NUC970
	default SENSOR_NT99141

config SENSOR_OV7725
	bool "OV7725"

config SENSOR_OV5640
	bool "OV5640"

config SENSOR_NT99141
        bool "NT99141"

config SENSOR_NT99050
	bool "NT99050"

config SENSOR_TW9912
        bool "TW9912"
endchoice

endif
```

## drivers/media/jpeg/Kconfig
```kconfig
#
# HW jpeg codec configuration
#


menu "NUC970/N9H30 JPEG CODEC"
	depends on VIDEO_DEV

comment "NUC970/N9H30 JPEG codec"

source "drivers/media/jpeg/nuc970/Kconfig"

endmenu # NUC970/N9H30 JPEG CODEC
```

## drivers/media/jpeg/nuc970/Kconfig
```kconfig
config NUC970_JPEG_CODEC
	tristate "NUC970 JPEG codec support"
	depends on ARCH_NUC970 && VIDEO_DEV
	---help---
	  Say Y here if you wnat to use NUC970's JPEG codec.

config JPEG_CODEC_BUFFER_SIZE
	hex "Max Raw data size - w*h*byteperpixel(hex) + Max Bistream Size"
	default 0xC8000
	depends on ARCH_NUC970 && VIDEO_DEV && NUC970_JPEG_CODEC
	help
	  Configure for jpeg encode data buffer size.
	  default is 640*480*2 raw data buffer + 100K (Raw data buffer * 0.4) output buffer
```

## drivers/net/can/nuc970_can/Kconfig
```kconfig
menuconfig NUC970_CAN
	tristate "NUC970/N9H30 CAN0/CAN1 devices"
	depends on HAS_IOMEM

if NUC970_CAN

config NUC970_CAN0
	bool "NUC970/N9H30 CAN0 support"
	help
	  This selects NUC970/N9H30 CAN0 driver

config ENABLE_CAN0_RX_WAKEUP
	bool "Enable CAN0 wake-up function"
	depends on NUC970_CAN0
	help
	  This selects NUC970/N9H30 CAN0 wake-up function
choice
	prompt "NUC970/N9H30 CAN0 pin selection"
	default NUC970_CAN0_PB
	depends on NUC970_CAN0
	help
	  Select CAN0 multi-function pin.

	config NUC970_CAN0_PB
		bool "Tx:PB11, Rx:PB10"
	config NUC970_CAN0_PH
		bool "Tx:PH3, Rx:PH2"
	config NUC970_CAN0_PI
		bool "Tx:PI4, Rx:PI3"
endchoice

config NUC970_CAN1
	bool "NUC970/N9H30 CAN1 support"
	help
	  This selects NUC970/N9H30 CAN1 driver

config ENABLE_CAN1_RX_WAKEUP
	bool "Enable CAN1 wake-up function"
	depends on NUC970_CAN1
	help
	  This selects NUC970/N9H30 CAN1 wake-up function

choice
	prompt "NUC970/N9H30 CAN1 pin selection"
	default NUC970_CAN1_PH
	depends on NUC970_CAN1
	help
	  Select CAN1 multi-function pin.

	config NUC970_CAN1_PH
		bool "Tx:PH15, Rx:PH14"
endchoice


endif
```

## drivers/net/ethernet/nuvoton/Kconfig
```kconfig
#
# Nuvoton network device configuration
#

config NET_VENDOR_NUVOTON
	bool "Nuvoton devices"
	default y
	depends on ARM && (ARCH_W90X900 || ARCH_NUC970)
	---help---
	  If you have a network (Ethernet) card belonging to this class, say Y
	  and read the Ethernet-HOWTO, available from
	  <http://www.tldp.org/docs.html#howto>.

	  Note that the answer to this question doesn't directly affect the
	  kernel: saying N will just cause the configurator to skip all
	  the questions about Nuvoton cards. If you say Y, you will be asked
	  for your specific card in the following questions.

if NET_VENDOR_NUVOTON

config W90P910_ETH
	tristate "Nuvoton w90p910 Ethernet support"
	depends on ARM && ARCH_W90X900
	select PHYLIB
	select NET_CORE
	select MII
	---help---
	  Say Y here if you want to use built-in Ethernet ports
	  on w90p910 processor.

config NUC970_ETH0
	tristate "Nuvoton NUC970 Ethernet MAC 0"
	depends on ARM && ARCH_NUC970
	select PHYLIB
	select NET_CORE
	select MII
	---help---
	  Say Y here if you want to use built-in Ethernet MAC 0
	  on NUC970 MCU.

choice
	prompt "NUC970 EMAC0 RMII and MDC/MDIO pin selection"
	default NUC970_ETH0_PF
	depends on NUC970_ETH0
	help
	  Select EMAC0 multi-function pin. Ether PA0~PA9 or PF0~PF9

	config NUC970_ETH0_PA
		bool "Port A"
	config NUC970_ETH0_PF
		bool "Port F"
endchoice

config NUC970_ETH1
	tristate "Nuvoton NUC970 Ethernet MAC 1"
	depends on ARM && ARCH_NUC970
	select PHYLIB
	select NET_CORE
	select MII
	---help---
	  Say Y here if you want to use built-in Ethernet MAC 1
	  on NUC970 MCU.

endif # NET_VENDOR_NUVOTON
```

## sound/soc/nuc970/Kconfig
```kconfig
##
## NUC970 series I2S API
##
config SND_SOC_NUC970
	tristate "SoC Audio for NUC970 series"
	depends on ARCH_NUC970
	help
	  This option enables support for I2S on the NUC970 SoC.

##
## Boards
##
config SND_SOC_NUC970EVB
	tristate "NUC970 I2S support for demo board"
	depends on SND_SOC_NUC970
	select SND_SOC_NAU8822
	help
	  Select this option to enable audio (I2S) on the
	  NUC970 demoboard.

choice
	prompt "I2S Mode Selection"
	depends on SND_SOC_NUC970EVB
	default SLAVE_MODE

config NUC970_I2S_MASTER_MODE
	bool "Master Mode"

config NUC970_I2S_SLAVE_MODE
	bool "Slave Mode"

endchoice
	
```
